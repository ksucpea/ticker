#include <PxMatrix.h>
#include <Ticker.h>
#include <ESP8266WiFi.h>
#include <ESP8266HTTPClient.h>
#include <WiFiClient.h>
#include <ArduinoJson.h>


const char* ssid = "butthair21";
const char* password = "diditupe";

#define P_LAT 16
#define P_A 5
#define P_B 4
#define P_C 15
#define P_OE 2
#define P_D 12

PxMATRIX display(64, 32, P_LAT, P_OE, P_A, P_B, P_C, P_D);

Ticker display_ticker;

uint16_t c_white = display.color565(255, 255, 255);
uint16_t c_red = display.color565(255, 0, 0);
uint16_t c_green = display.color565(0, 255, 0);
uint16_t c_blue = display.color565(0, 0, 255);
uint16_t c_orange = display.color565(247, 99, 7);
uint16_t c_yellow = display.color565(247, 239, 7);
uint16_t c_purple = display.color565(200, 50, 255);

const unsigned short catArr[][1134] PROGMEM = {
  {
    0x0000, 0x0000, 0x0000, 0x0000, 0x0000, 0x0000, 0x0000, 0x0000, 0x0000, 0x0000, 0x0000, 0x0000, 0x0000, 0x0000, 0x0000, 0x0000,  // 0x0010 (16) pixels
    0x0000, 0x0000, 0x0000, 0x0000, 0x0000, 0x0000, 0x0000, 0x0000, 0x0000, 0x0000, 0x0000, 0x0000, 0x0000, 0x0000, 0x0000, 0x0000,  // 0x0020 (32) pixels
    0x0000, 0x0000, 0x0000, 0x0000, 0x0000, 0x0000, 0x0000, 0x0000, 0x0000, 0x0000, 0x0000, 0x0000, 0x0000, 0x0000, 0x0000, 0x0000,  // 0x0030 (48) pixels
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    0x0000, 0x0000, 0x0000, 0x0000, 0x0000, 0x0000, 0x0000, 0x0000, 0x0000, 0x0000, 0x0000, 0x0000, 0x0000, 0x0000, 0x0000, 0x0000,  // 0x0460 (1120) pixels
  },
  {
    0x0000, 0x0000, 0x0000, 0x0000, 0x0000, 0x0000, 0x0000, 0x0000, 0x0000, 0x0000, 0x0000, 0x0000, 0x0000, 0x0000, 0x0000, 0x0000,  // 0x0010 (16) pixels
    0x0000, 0x0000, 0x0000, 0x0000, 0x0000, 0x0000, 0x0000, 0x0000, 0x0000, 0x0000, 0x0000, 0x0000, 0x0000, 0x0000, 0x0000, 0x0000,  // 0x0020 (32) pixels
    0x0000, 0x0000, 0x0000, 0x0000, 0x0000, 0x0000, 0x0000, 0x0000, 0x0000, 0x0000, 0x0000, 0x0000, 0x0000, 0x0000, 0x0000, 0x0000,  // 0x0030 (48) pixels
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    0x0000, 0x0000, 0x0000, 0x0000, 0x0000, 0x0000, 0x0000, 0x0000, 0x0000, 0x0000, 0x0000, 0x0000, 0x0000, 0x0000, 0x0000, 0x0000,  // 0x0460 (1120) pixels
  },
  {
    0x0000, 0x0000, 0x0000, 0x0000, 0x0000, 0x0000, 0x0000, 0x0000, 0x0000, 0x0000, 0x0000, 0x0000, 0x0000, 0x0000, 0x0000, 0x0000,  // 0x0010 (16) pixels
    0x0000, 0x0000, 0x0000, 0x0000, 0x0000, 0x0000, 0x0000, 0x0000, 0x0000, 0x0000, 0x0000, 0x0000, 0x0000, 0x0000, 0x0000, 0x0000,  // 0x0020 (32) pixels
    0x0000, 0x0000, 0x0000, 0x0000, 0x0000, 0x0000, 0x0000, 0x0000, 0x0000, 0x0000, 0x0000, 0x0000, 0x0000, 0x0000, 0x0000, 0x0000,  // 0x0030 (48) pixels
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    0xA4D9, 0xA4D9, 0xA4D9, 0x0000, 0x0000, 0x0000, 0x0000, 0x0000, 0x0000, 0x0000, 0x0000, 0x0000, 0x0000, 0x0000, 0x0000, 0x0000,  // 0x0460 (1120) pixels
  },
  {
    0x0000, 0x0000, 0x0000, 0x0000, 0x0000, 0x0000, 0x0000, 0x0000, 0x0000, 0x0000, 0x0000, 0x0000, 0x0000, 0x0000, 0x0000, 0x0000,  // 0x0010 (16) pixels
    0x0000, 0x0000, 0x0000, 0x0000, 0x0000, 0x0000, 0x0000, 0x0000, 0x0000, 0x0000, 0x0000, 0x0000, 0x0000, 0x0000, 0x0000, 0x0000,  // 0x0020 (32) pixels
    0x0000, 0x0000, 0x0000, 0x0000, 0x0000, 0x0000, 0x0000, 0x0000, 0x0000, 0x0000, 0x0000, 0x0000, 0x0000, 0x0000, 0x0000, 0x0000,  // 0x0030 (48) pixels
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    0x0000, 0xA4D9, 0xA4D9, 0xA4D9, 0x0000, 0x0000, 0x0000, 0x0000, 0x0000, 0x0000, 0x0000, 0x0000, 0x0000, 0x0000, 0x0000, 0x0000,  // 0x0460 (1120) pixels
  },
  {
    0x0000, 0x0000, 0x0000, 0x0000, 0x0000, 0x0000, 0x0000, 0x0000, 0x0000, 0x0000, 0x0000, 0x0000, 0x0000, 0x0000, 0x0000, 0x0000,  // 0x0010 (16) pixels
    0x0000, 0x0000, 0x0000, 0x0000, 0x0000, 0x0000, 0x0000, 0x0000, 0x0000, 0x0000, 0x0000, 0x0000, 0x0000, 0x0000, 0x0000, 0x0000,  // 0x0020 (32) pixels
    0x0000, 0x0000, 0x0000, 0x0000, 0x0000, 0x0000, 0x0000, 0x0000, 0x0000, 0x0000, 0x0000, 0x0000, 0x0000, 0x0000, 0x0000, 0x0000,  // 0x0030 (48) pixels
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    0x0000, 0x0000, 0xA4D9, 0xA4D9, 0x0000, 0x0000, 0x0000, 0x0000, 0x0000, 0x0000, 0x0000, 0x0000, 0x0000, 0x0000, 0x0000, 0x0000,  // 0x0460 (1120) pixels
  },
  {
    0x0000, 0x0000, 0x0000, 0x0000, 0x0000, 0x0000, 0x0000, 0x0000, 0x0000, 0x0000, 0x0000, 0x0000, 0x0000, 0x0000, 0x0000, 0x0000,  // 0x0010 (16) pixels
    0x0000, 0x0000, 0x0000, 0x0000, 0x0000, 0x0000, 0x0000, 0x0000, 0x0000, 0x0000, 0x0000, 0x0000, 0x0000, 0x0000, 0x0000, 0x0000,  // 0x0020 (32) pixels
    0x0000, 0x0000, 0x0000, 0x0000, 0x0000, 0x0000, 0x0000, 0x0000, 0x0000, 0x0000, 0x0000, 0x0000, 0x0000, 0x0000, 0x0000, 0x0000,  // 0x0030 (48) pixels
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    0x0000, 0x0000, 0xA4D9, 0xA4D9, 0xA4D9, 0x0000, 0x0000, 0x0000, 0x0000, 0x0000, 0x0000, 0x0000, 0x0000, 0x0000, 0x0000, 0x0000,  // 0x0460 (1120) pixels
  }
};



void display_updater() {
  display.display(30);
}

unsigned long start_time = 0;
unsigned long startSec = 0;
unsigned long timer200 = 0;
bool fake = false;
int hour = -1;
int minute = -1;
int second = -1;
const int pauseTime = 7;

void setup() {
  Serial.setTimeout(5000);
  delay(5000);
  Serial.begin(9600);
  display.begin(16);
  display.setFastUpdate(true);
  display.setTextWrap(false);
  display_ticker.attach(.001, display_updater);
  display.flushDisplay();
  display.setTextColor(c_blue);
  display.setCursor(1, 1);
  display.print("Connecting");
  networkConnect();
  getApiData();
}

void loop() {
  scrollStocks();
  getApiData();
}

void getApiData() {
  getStockData();
  getWeatherData();
  getTime();
}

void getTime() {
  String host = "https://timeapi.io";
  String url = "/api/Time/current/zone?timeZone=America/New_York";
  WiFiClientSecure client;
  HTTPClient sender;
  client.setInsecure();
  client.connect(host, 443);


  if (sender.begin(client, host + url)) {
    int httpCode = sender.GET();

    char process[] = "012345678901234";
    String find0 = "hour\":";
    String find1 = "minute\":";
    String find2 = "seconds\":";
    while (client.available()) {

      for (int i = 1; i < 15; i++) {
        process[i - 1] = process[i];
      }
      process[14] = client.read();

      if (foundIn(process, find0)) {
        hour = client.readStringUntil(',').toInt();
      }
      if (foundIn(process, find1)) {
        minute = client.readStringUntil(',').toInt();
      }
      if (foundIn(process, find2)) {
        second = client.readStringUntil(',').toInt();
      }
    }

    Serial.println(String(hour) + ":" + String(minute) + ":" + String(second));

  } else {
    Serial.printf("Other HTTP error");
    sender.end();
  }
}

void networkConnect() {
  Serial.println("connecting to wifi");
  WiFi.mode(WIFI_STA);
  WiFi.begin(ssid, password);
  while (WiFi.status() != WL_CONNECTED) {
    delay(500);
    Serial.print("*");
  }
  Serial.println("Connected to wifi");
}


String stocks[] = { "AAPL", "AMC", "AMZN", "DIS", "LUV", "META", "MSFT", "NFLX", "NKE", "PYPL", "RBLX", "TSLA", "V", "WMT", "^DJI" };
const int numStocks = sizeof(stocks) / sizeof(stocks[0]);
const int numSlides = numStocks + 3;

double prices2[numStocks];
String changes2[numStocks];
bool positives2[numStocks];
int8_t marketOpen = -1;
String currentTemp = "";
String currentWeather = "";

void getWeatherData() {
  Serial.println("GETTING WEATHER DATA... ");
  String host = "https://api.open-meteo.com";
  WiFiClientSecure client;
  HTTPClient sender;
  client.setInsecure();
  client.connect(host, 443);
  String url = "/v1/forecast?latitude=38.98&longitude=-76.94&current_weather=true&temperature_unit=fahrenheit&windspeed_unit=mph&timezone=America%2FNew_York";

  if (sender.begin(client, host + url)) {
    int httpCode = sender.GET();

    char process[] = "012345678901234";
    String find0 = "temperature\":";
    String find1 = "weathercode\":";
    while (client.available()) {

      for (int i = 1; i < 15; i++) {
        process[i - 1] = process[i];
      }
      process[14] = client.read();

      if (foundIn(process, find0)) {
        currentTemp = client.readStringUntil('.') + "F";
      }

      if (foundIn(process, find1)) {
        double code = client.readStringUntil(',').toDouble();
        if (code == 0 || code == 1) {
          currentWeather = "Clear";
        } else if (code == 2) {
          currentWeather = "P Cloudy";
        } else if (code == 3) {
          currentWeather = "Cloudy";
        } else if (code >= 51 && code <= 57 || code == 80) {
          currentWeather = "Drizzle";
        } else if (code >= 61 && code <= 67 || code >= 81 && code <= 82) {
          currentWeather = "Rain";
        } else if (code >= 71 && code <= 77 || code == 85 || code == 86) {
          currentWeather = "Snow";
        } else if (code >= 95 && code <= 99) {
          currentWeather = "Thunder";
        } else {
          currentWeather = "";
        }
      }
    }
  } else {
    Serial.printf("Other HTTP error");
    sender.end();
  }
}

void getStockData() {
  Serial.println("GETTING STOCK DATA...");
  String host = "https://query2.finance.yahoo.com";
  WiFiClientSecure client;
  HTTPClient sender;
  client.setInsecure();
  client.connect(host, 443);

  String stocksToString = "";
  for (int i = 0; i < numStocks; i++) {
    stocksToString = stocksToString + stocks[i] + (i < numStocks - 1 ? "," : "");
  }

  Serial.println(stocksToString);

  String url = "/v7/finance/quote?symbols=" + stocksToString + "&fields=shortName%2CregularMarketPrice%2CregularMarketChangePercent";

  String find = "MarketPrice\":";
  String find2 = "ChangePercent\":";
  String find3 = "marketState\":";
  int rmpIndex = 0, rmcpIndex = 0;
  char process[] = "012345678901234";
  if (sender.begin(client, host + url)) {
    int httpCode = sender.GET();

    while (rmpIndex < numStocks && client.available()) {
      for (int i = 1; i < 15; i++) {
        process[i - 1] = process[i];
      }
      process[14] = client.read();

      if (foundIn(process, find)) {
        prices2[rmpIndex] = client.readStringUntil(',').toDouble();
        rmpIndex++;
      }


      if (foundIn(process, find2)) {
        double change = client.readStringUntil(',').toDouble();
        positives2[rmcpIndex] = change >= 0;
        changes2[rmcpIndex] = (change >= 0 ? "+" : "") + String(change) + "%";
        rmcpIndex++;
      }


      if (marketOpen < 0 && foundIn(process, find3)) {
        if (client.readStringUntil(',').compareTo("\"REGULAR\"") == 0) {
          marketOpen = 1;
        }
      }
    }

    Serial.println("PRICES BEGIN");
    for (int i = 0; i < numStocks; i++) {
      Serial.print(String(prices2[i]) + ", ");
    }
    Serial.println();
    for (int i = 0; i < numStocks; i++) {
      Serial.print("change = " + String(changes2[i]));
    }
    Serial.println("PRICES END");

  } else {
    Serial.printf("Other HTTP error");
    sender.end();
  }
}

bool foundIn(char arr[], String find) {
  int j = find.length() - 1;
  for (int i = 14; j >= 0; i--) {
    if (find.charAt(j) != arr[i]) {
      return false;
    }
    j--;
  }
  return true;
}

void scrollStocks() {
  startSec = millis();
  timer200 = millis();

  int scrollLength = 1;
  bool pause = false;
  int pauseSec = 0;
  int catPos = 0;
  int x1 = 0, x2 = marketOpen == 1 ? 24 : 36, y1 = 12, y2 = 20;
  bool right = true, down = true;
  while (scrollLength < (numSlides + 1) * 64) {
    display.setBrightness(60);
    second = (millis() - startSec) / 1000;

    if (second >= 60) {
      minute++;
      second = 0;
      startSec = millis();
    }
    if (minute >= 60) {
      minute = 0;
      hour++;
    }

    if (pause == false) {
      display.clearDisplay();
      scrollLength++;
    } else if (pause == true && second == pauseSec) {
      pause = false;
      scrollLength++;
    } else if (pause == true) {
    }

    for (int i = 0; i < numSlides; i++) {
      int xOffset = 64 - scrollLength + (i * 64);
      if (xOffset < -64 || xOffset > 64) continue;  // if not visible -> IGNORE!
      if (xOffset == 1 && pause == false) {         // if the slide reaches 1 -> NEED TO PAUSE!
        pause = true;
        pauseSec = second + pauseTime < 60 ? second + pauseTime : second + pauseTime - 60;
      }

      if (i >= numStocks) {  // NON-STOCK SLIDES

        int slideNum = i - numStocks;
        if (slideNum == 0) {
          if (pause) display.clearDisplay();
          int hour12 = hour > 12 ? hour - 12 : hour;
          display.setTextColor(c_red);
          display.setCursor(xOffset + 1, 1);
          display.setTextSize(2);
          display.print((hour12 < 10 ? "0" : "") + String(hour12));
          display.setTextSize(1);
          display.setTextColor(c_orange);
          display.setCursor(xOffset + 1, 16);
          display.print((second < 10 ? "0" : "") + String(second));
          display.setTextColor(c_yellow);
          display.setCursor(xOffset + 26, 1);
          display.print((minute < 10 ? "0" : "") + String(minute));
          display.setCursor(xOffset + 39, 1);
          display.print((hour >= 12 ? "PM" : "AM"));
          display.setTextSize(2);
          display.setTextColor(c_green);
          display.setCursor(xOffset + 26, 9);
          display.println(currentTemp);
          display.setTextSize(1);
          display.setTextColor(c_blue);
          display.setCursor(xOffset + (63 - (currentWeather.length() * 6)), 24);
          display.println(currentWeather);
        } else if (slideNum == 1) {
          if (millis() / 31 != timer200) {
            timer200 = millis() / 31;
            if (right == true) {
              x1++;
              x2++;
              if (x2 == 64) {
                right = false;
              }
            } else {
              x1--;
              x2--;
              if (x1 == 0) {
                right = true;
              }
            }
            if (down == true) {
              y1++;
              y2++;
              if (y2 == 32) {
                down = false;
              }
            } else {
              y1--;
              y2--;
              if (y1 == 0) {
                down = true;
              }
            }
          }
          if (pause == true) display.clearDisplay();
          display.setTextColor(marketOpen == 1 ? c_green : c_red);
          display.setCursor(xOffset + x1, y1);
          if (fake == false) display.print(marketOpen == 1 ? "OPEN" : "CLOSED");
        } else if (slideNum >= 2) {
          if (millis() / 100 != catPos) {
            catPos = millis() / 100;
          }
          display.drawRGBBitmap(xOffset + 8, 5, catArr[catPos % 5], 54, 21);
        }
      } else {
        display.setTextColor(c_white);
        display.setTextSize(2);
        display.setCursor(xOffset, 1);
        display.println("$" + stocks[i]);
        display.setTextSize(1);
        display.setTextColor(positives2[i] ? c_green : c_red);
        display.setCursor(xOffset + 12, 16);
        display.println(changes2[i]);
        display.setCursor(xOffset + 12, 24);
        display.println(prices2[i]);
        drawArrow(positives2[i], xOffset + 1, 21);
      }
    }

    start_time = millis();
    while ((millis() - start_time) < 5) {
      display.display(5);
    }
  }
}

void drawArrow(bool up, int x, int y) {

  uint16_t color = up ? c_green : c_red;

  if (up) {
    display.fillTriangle(x, y + 4, x + 4, y, x + 8, y + 4, c_green);
  } else {
    display.fillTriangle(x, y, x + 4, y + 4, x + 8, y, c_red);
  }
  //display.fillTriangle(int16_t x, int16_t y0, int16_t x1, int16_t y1, int16_t x2, int16_t y2, uint16_t color);

  /*
  for(int i = 0; i < 4; i++) {
    display.fillRect(x + i, y + i, 9 - (i * 2), 1, color);    
  }
  */
}